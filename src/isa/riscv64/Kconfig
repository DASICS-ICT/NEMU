## src/isa/riscv64/Kconfig
```kconfig
menu "ISA-dependent Options for riscv64"

config CLINT_MMIO
  hex "MMIO address of CLINT"
  default 0xa2000000

config MULTICORE_DIFF
  bool "(Beta) Enable multi-core difftest APIs for RISC-V"
  default false

config RVB
  bool "RISC-V Bitmanip Extension v1.0"
  default y

config RVK
  bool "RISC-V Cryptography Extension v1.0"
  default y

config RVV
  bool "RISC-V Vector Extension v1.0"
  default y

config RVN
  bool "RISC-V User-Level Interrupts Extension v1.1"
  default y

config RV_DEBUG
  bool "RISC-V Debug Extension"
  default y

config RV_DASICS
  bool "Enable DASICS Protection Mechanism for RV64"
  default y

config RV_DASICS_TREG_ZERO
  depends on RV_DASICS && !PERF_OPT && !RVV
  bool "Enable DASICS treg-zero init-bit reference model"
  default n
  help
    Model the architectural-visible behavior of DASICS treg-zero. dasicscall.j/jr
    commit clears init_bit of caller-saved int (x5-x7,x28-x31) and fp
    (f0-f7,f28-f31) regs. Untrusted source reads of uninitialized regs are
    masked to zero. RVV is not supported because vector load/store operands are
    not part of this scalar init-bit model.

config RV_PMP_CSR
  bool "Enable PMP CSR Read & Write"
  default y

config RV_PMP_NUM
  depends on RV_PMP_CSR
  int "Number of PMP CSR registers"
  default 16
  range 0 16

config RV_PMP_CHECK
  # todo: pmp check still not work when enable PERF_OPT
  depends on !PERF_OPT
  depends on RV_PMP_CSR
  bool "Enable PMP Check"
  default y

config RV_SVINVAL
  bool "Enable VM Extension Svinval"
  default y

config MISA_UNCHANGEABLE
  bool "Make misa cannot be changed by CSR write instructions like XS"
  default y

config XTVEC_VECTORED_MODE
  bool "Support Vectored MODE of mtvec/stvec"
  default y

config RV_ARCH_CSRS
  bool "Enable mvendorid, marchid, mimpid CSR"
  default y

config USE_XS_ARCH_CSRS
  depends on RV_ARCH_CSRS
  bool "Use the same arch CSRS values as the implementation of XiangShan"

config MVENDORID_VALUE
  depends on RV_ARCH_CSRS
  depends on !USE_XS_ARCH_CSRS
  hex "Value of CSR mvendorid"
  default 0x0

config MARCHID_VALUE
  depends on RV_ARCH_CSRS
  depends on !USE_XS_ARCH_CSRS
  hex "Value of CSR marchid"
  default 0x0

config MIMPID_VALUE
  depends on RV_ARCH_CSRS
  depends on !USE_XS_ARCH_CSRS
  hex "Value of CSR mimpid"
  default 0x0

endmenu
```
